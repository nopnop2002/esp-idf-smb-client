## smb2-ls/main/Kconfig.projbuild
```kconfig
menu "Application Configuration"

	config ESP_WIFI_SSID
		string "WiFi SSID"
		default "myssid"
		help
			SSID (network name) to connect to.

	config ESP_WIFI_PASSWORD
		string "WiFi Password"
		default "mypassword"
		help
			WiFi password (WPA or WPA2) to use.

	config ESP_MAXIMUM_RETRY
		int "Maximum retry"
		default 5
		help
			Set the Maximum retry to avoid station reconnecting to the AP unlimited when the AP is really inexistent.

	config ESP_SMB_USER
		string "SMB Username"
		default "smbuser"
		help
			Username with shared folder permissions.

	config ESP_NEED_PASSWORD
		bool "Shared access requires password"
		help
			Shared access requires password

	config ESP_SMB_PASSWORD
		depends on ESP_NEED_PASSWORD
		string "SMB password"
		default "smbpass"
		help
			Password of Username.

	config ESP_SMB_HOST
		string "SMB Host"
		default "192.168.10.10"
		help
			IP address of shared host.
			mDMS name cannot be used.

	config ESP_SMB_PATH
		string "SMB shared path"
		default "path"
		help
			Shared path name.

endmenu
```

## smb2-mkdir/main/Kconfig.projbuild
```kconfig
menu "Application Configuration"

	config ESP_WIFI_SSID
		string "WiFi SSID"
		default "myssid"
		help
			SSID (network name) to connect to.

	config ESP_WIFI_PASSWORD
		string "WiFi Password"
		default "mypassword"
		help
			WiFi password (WPA or WPA2) to use.

	config ESP_MAXIMUM_RETRY
		int "Maximum retry"
		default 5
		help
			Set the Maximum retry to avoid station reconnecting to the AP unlimited when the AP is really inexistent.

	config SMB_USER
		string "SMB Username"
		default "smbuser"
		help
			Username with shared folder permissions.

	config SMB_NEED_PASSWORD
		bool "Shared access requires password"
		help
			Shared access requires password

	config SMB_PASSWORD
		depends on SMB_NEED_PASSWORD
		string "SMB password"
		default "smbpass"
		help
			Password of Username.

	config SMB_HOST
		string "SMB Host"
		default "192.168.10.10"
		help
			IP address of shared host.
			mDMS name cannot be used.

	config SMB_PATH
		string "SMB shared path"
		default "path"
		help
			Shared path name.

endmenu
```
